## conf/layer.conf
```bitbake
BBPATH .= ":${LAYERDIR}"
BBFILES += "${LAYERDIR}/recipes-*/*/*.bb \
            ${LAYERDIR}/recipes-*/*/*.bbappend"
BBFILE_COLLECTIONS += "meta-lutils"
BBFILE_PATTERN_meta-lutils = "^${LAYERDIR}/"
BBFILE_PRIORITY_meta-lutils = "6"
LAYERDEPENDS_meta-lutils = "core"
LAYERSERIES_COMPAT_meta-lutils = "nanbield"
```
